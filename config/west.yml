## config/west.yml
```yaml
manifest:
  remotes:
    - name: zmkfirmware
      url-base: https://github.com/zmkfirmware
    - name: urob
      url-base: https://github.com/urob

  projects:
    - name: zmk
      remote: zmkfirmware
      revision: main
      import: app/west.yml

    - name: zmk-tri-state
      remote: urob
      revision: main
      path: modules/tri-state

    - name: zmk-helpers
      remote: urob
      revision: main
      path: modules/helpers

    - name: zmk-auto-layer
      remote: urob
      revision: main
      path: modules/auto-layer
  self:
    path: config
```
